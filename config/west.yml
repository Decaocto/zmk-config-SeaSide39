## config/west.yml
```yaml
manifest:
  remotes:
    - name: zmkfirmware
      url-base: https://github.com/zmkfirmware
  projects:
    - name: zmk
      remote: zmkfirmware
      revision: main
      import: app/west.yml
    # zmk-pmw3610-driver のブロックを丸ごと削除しました
    - name: zmk-rgbled-widget
      url: https://github.com/caksoylar/zmk-rgbled-widget
      revision: main
  self:
    path: config
```
